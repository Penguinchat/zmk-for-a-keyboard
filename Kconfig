## config/Kconfig
```kconfig
rsource "config/app/drivers/Kconfig"
# Copyright (c) 2022-2023 XiNGRZ
# SPDX-License-Identifier: MIT

rsource "app/Kconfig"
rsource "drivers/Kconfig"
```

## config/boards/shields/keypad/Kconfig.shield
```kconfig
# Copyright (c) 2020 The ZMK Contributors
# SPDX-License-Identifier: MIT

config SHIELD_KEYPAD
    def_bool $(shields_list_contains,keypad)
```

## config/drivers/led_strip/Kconfig
```kconfig
config LED_STRIP_REMAP
    bool "LED Strip Remapping Support"
    default y
    help
      Enable LED strip remapping and layer indicators

config ZMK_LED_INDICATORS
    bool "ZMK LED Indicators"
    default y
    depends on LED_STRIP_REMAP
```

## config/drivers/led_strip_remap/Kconfig.remap
```kconfig
# LED Strip Remapping Driver Configuration
menuconfig LED_STRIP_REMAP
    bool "LED Strip Remapping Driver"
    depends on LED_STRIP
    default y
    help
      Enable dynamic remapping and layered rendering for addressable LED strips (e.g., WS2812).
      Supports priority-based rendering (base layer → indicators → layer indicators) [1,2](@ref).

if LED_STRIP_REMAP

config LED_STRIP_REMAP_CHAIN_LENGTH
    int "Logical LED chain length"
    range 1 256
    default 10
    help
      Number of virtual LEDs in the remapping chain.
      Must match the value defined in the device tree [2,3](@ref).

config LED_STRIP_REMAP_MAX_LAYERS
    int "Maximum layer indicator groups"
    range 1 8
    default 3
    help
      Maximum number of independent layer indicator groups (e.g., for keyboard layers).
      Each group requires 4 pre-defined colors (RGB for layers 0-3) [5](@ref).

config LED_STRIP_REMAP_INDICATOR_PRIORITY
    bool "Enable indicator priority override"
    default y
    help
      Allow layer indicators to override base/indicator colors (highest priority).
      Disable this to reduce rendering overhead [1,7](@ref).

config LED_STRIP_REMAP_DYNAMIC_MAP
    bool "Support runtime remapping table"
    depends on !SMP
    default n
    help
      Enable dynamic remapping table updates at runtime.
      Note: Requires exclusive access to avoid concurrency issues [2,6](@ref).

config LED_STRIP_REMAP_DEBUG
    bool "Enable debug logs"
    default n
    depends on LOG
    help
      Enable verbose debugging output for rendering pipeline.
      Increases flash usage and reduces performance [4,5](@ref).

endif  # LED_STRIP_REMAP
```

## config/dts/bindings/led_strip/zmk,led-strip-remap.yaml
```yaml
# SPDX-License-Identifier: MIT

description: |
  Virtual LED strip driver for reordering LEDs with custom indicator APIs.

compatible: "zmk,led-strip-remap"

properties:
  chain-length:
    type: int
    required: true
    description: Total physical LEDs in the strip.

  led_strip:
    type: phandle
    required: true
    description: Reference to the physical LED strip node.

  map:
    type: array
    required: true
    description: LED remapping indices (e.g., [0, 2, 1]).

child-binding:
  description: Configuration for LED indicators (e.g., layer indicators).
  properties:
    led-indexes:  # 使用连字符命名（绑定文件要求）
      type: array
      required: true
      description: Physical LED indices for indicators.

    colors:       # 新增颜色属性
      type: array
      required: true
      description: Layer colors in 32-bit RGB format (0xRRGGBB).

  required:      # 强制要求子节点必须包含的属性
    - led-indexes
    - colors
```

## config/west.yml
```yaml
manifest:
  remotes:
    - name: zmkfirmware
      url-base: https://github.com/zmkfirmware
      - name: penguinchat
      url-base: https://github.com/penguinchat
  projects:
    - name: zmk
      remote: zmkfirmware
      revision: main
      import: app/west.yml
    - name: zmk-for-a-keyboard
      remote: penguinchat
      revision: main
  self:
    path: config
```
